## conf/distro/styl-imx-fb.conf
```bitbake
# i.MX DISTRO for the FrameBuffer graphical backend.

include conf/distro/include/fsl-imx-base.inc
include conf/distro/include/fsl-imx-preferred-env.inc

DISTRO = "styl-imx-fb"
DISTRO_NAME = "STYL Framebuffer Distro - Based on NXP i.MX Release Distro"
DISTRO_VERSION = "4.9.88-2.0.0"

# Remove conflicting backends.
DISTRO_FEATURES_remove = "x11 wayland directfb "
DISTRO_FEATURES_append = " systemd opengl sysvinit" 
VIRTUAL-RUNTIME_init_manager = "systemd"
DISTRO_FEATURES_BACKFILL_CONSIDERED = "sysvinit"
VIRTUAL-RUNTIME_initscripts = ""
```

## conf/distro/styl-imx-flasher.conf
```bitbake
# STYL DISTRO for the FrameBuffer graphical backend.

include conf/distro/include/fsl-imx-base.inc
include conf/distro/include/fsl-imx-preferred-env.inc

DISTRO = "styl-imx-flasher"
DISTRO_NAME = "STYL Flasher Distro - Based on NXP i.MX Release Distro"
DISTRO_VERSION = "4.9.88-2.0.0"

# Remove conflicting backends.
DISTRO_FEATURES_remove = "x11 wayland directfb "
```

## conf/layer.conf
```bitbake
# We have a conf and classes directory, add to BBPATH
BBPATH .= ":${LAYERDIR}"

# We have recipes-* directories, add to BBFILES
BBFILES += "${LAYERDIR}/recipes-*/*/*.bb \
            ${LAYERDIR}/recipes-*/*/*/*.bb \
	    ${LAYERDIR}/recipes-*/*/*.bbappend"

BBFILE_COLLECTIONS += "styl-layer"
BBFILE_PATTERN_styl-layer = "^${LAYERDIR}/"
BBFILE_PRIORITY_styl-layer = "7"

# Add the Freescale-specific licenses into the metadata
LICENSE_PATH += "${LAYERDIR}/custom-licenses"

FSL_EULA_FILE = "${LAYERDIR}/EULA"

IMX_MIRROR ?= "http://www.freescale.com/lgfiles/NMG/MAD/YOCTO/"
QORIQ_MIRROR ?= "http://git.freescale.com/source/"

# FIXME: set this to avoid changing all the recipes that use it
FSL_MIRROR ?= "${IMX_MIRROR}"

MIRRORS += " \
${IMX_MIRROR}   http://download.ossystems.com.br/bsp/freescale/source/ \n \
${QORIQ_MIRROR} http://download.ossystems.com.br/bsp/freescale/source/ \n \
"

# The dynamic-layers directory hosts the extensions and layer specific
# modifications related to Freescale products.
#
# The .bbappend and .bb files are included if the respective layer
# collection is available.
BBFILES += "${@' '.join('${LAYERDIR}/dynamic-layers/%s/recipes*/*/*.bbappend' % layer \
               for layer in BBFILE_COLLECTIONS.split())}"
BBFILES += "${@' '.join('${LAYERDIR}/dynamic-layers/%s/recipes*/*/*.bb' % layer \
               for layer in BBFILE_COLLECTIONS.split())}"

BBMASK += "meta-freescale/recipes-graphics/clutter/clutter-1.0_%.bbappend"
BBMASK += "meta-fsl-bsp-release/imx/meta-bsp/recipes-security/optee-imx/optee-os-imx_git.bb"
```

## conf/machine/bigeye.conf
```bitbake
#@TYPE: Machine
#@NAME: Bigeye platform
#@SOC: i.MX6ULL
#@DESCRIPTION: Machine configuration for STYL Bigeye platform
#@MAINTAINER: Alvin Nguyen <alvin.nguyen@styl.solutions>

include conf/machine/include/styl-imx6ull.inc

KERNEL_DEVICETREE = "imx6ull-14x14-bigeye.dtb imx6ull-14x14-bigeye-wifi.dtb imx6ull-14x14-bigeye-flasher.dtb"

UBOOT_CONFIG = "bigeye"

BOOT_SCRIPTS = "bigeye-sdcard.scr:boot-sdcard.scr 	\
		bigeye-wifi.scr:boot-wifi.scr		\
		bigeye-manual.scr:boot-manual.scr	\
		bigeye-wifi.scr:boot.scr		\
"

# Effect to "recipes-connectivity/networkmanager/networkmanager_1.4.4.bbappend" and others
MACHINE_FEATURES_append = " wifi bluetooth gsm"

# Effect to "recipes-test/packagegroup/packagegroup-core-tools-testapps.bbappend"
DISTRO_FEATURES_append = " networkmanager"
```

## conf/machine/include/styl-imx6ull-default-versions.inc
```bitbake
# Bigeye BSP default versions
PREFERRED_VERSION_wlconf = "8.7.3"
PREFERRED_VERSION_wl18xx-fw = "8.9.0.0.78"
```

## conf/machine/include/styl-imx6ull.inc
```bitbake
#@TYPE: Machine
#@NAME: Bigeye Gateway platform
#@SOC: i.MX6ULL
#@DESCRIPTION: Machine configuration for STYL Bigeye Gateway platform
#@MAINTAINER: Alvin Nguyen <alvin.nguyen@styl.solutions>

MACHINEOVERRIDES =. "mx6:mx6ul:mx6ull:"

include conf/machine/include/imx-base.inc
include conf/machine/include/tune-cortexa7.inc
require conf/machine/include/styl-imx6ull-default-versions.inc
require conf/machine/include/styl-imx6ull-default-providers.inc
require conf/machine/include/styl-imx6ull-default-settings.inc

MACHINE_FIRMWARE_append = " firmware-imx-epdc"

OPTEE_BIN_EXT = "6ullevk"

SERIAL_CONSOLE = "115200 ttymxc0"

###################### UBOOT ###################################################
UBOOT_CONFIG ??= "${@bb.utils.contains('COMBINED_FEATURES', 'optee', 'sd-optee', 'sd', d)}"
UBOOT_CONFIG[sd] = "mx6ull_14x14_evk_config,sdcard"
UBOOT_CONFIG[emmc] = "mx6ull_14x14_evk_emmc_config,sdcard"
UBOOT_CONFIG[nand] = "mx6ull_14x14_evk_nand_config,ubifs"
UBOOT_CONFIG[qspi1] = "mx6ull_14x14_evk_qspi1_config"
UBOOT_CONFIG[mfgtool] = "mx6ull_14x14_evk_config"
UBOOT_CONFIG[sd-optee] = "mx6ull_14x14_evk_optee_config"
UBOOT_CONFIG[bigeye] = "mx6ull_14x14_bigeye_config"

###################### ROOTFS ##################################################
IMAGE_FSTYPES += " sdcard tar.bz2"

BOOT_SPACE = "20480"
```
